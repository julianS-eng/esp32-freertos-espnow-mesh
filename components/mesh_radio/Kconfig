## components/mesh_radio/Kconfig
```kconfig
menu "ESP-NOW mesh radio"

    choice MESH_RADIO_BACKEND
        prompt "Radio backend"
        default MESH_RADIO_ESPNOW
        help
            ESP-NOW is the real radio. The loopback backends are test doubles
            that never touch the RF hardware, so the complete firmware (tasks,
            queues, retries, JSON output) can run under Espressif's QEMU, which
            does not emulate the Wi-Fi PHY. They are used by CI for boot smoke
            tests and to measure task stack high-water marks.

        config MESH_RADIO_ESPNOW
            bool "ESP-NOW (real radio)"
        config MESH_RADIO_LOOPBACK_GATEWAY
            bool "Loopback: emulated gateway (run a sensor node without a gateway / in QEMU)"
        config MESH_RADIO_LOOPBACK_NODES
            bool "Loopback: emulated sensor nodes (run the gateway without nodes / in QEMU)"
    endchoice

    config MESH_LOOPBACK_LOSS_PCT
        int "Loopback: frame loss probability (%)"
        depends on !MESH_RADIO_ESPNOW
        range 0 90
        default 5

    config MESH_LOOPBACK_NODE_COUNT
        int "Loopback: number of emulated nodes"
        depends on MESH_RADIO_LOOPBACK_NODES
        range 1 16
        default 4

    config MESH_WIFI_CHANNEL
        int "Wi-Fi channel shared by the whole mesh"
        range 1 13
        default 1
        help
            ESP-NOW peers must be on the same primary channel. The gateway and
            every node are pinned to this channel (no scanning, see
            docs/ARCHITECTURE.md "Future work").

    config MESH_LONG_RANGE
        bool "Enable Espressif Long Range (LR) PHY mode"
        default n
        help
            Adds WIFI_PROTOCOL_LR to the station interface. Increases range
            at 512/256 kbit/s; every device in the mesh must enable it.

    config MESH_TX_POWER_QDBM
        int "Maximum TX power (units of 0.25 dBm)"
        range 8 84
        default 78
        help
            Passed to esp_wifi_set_max_tx_power(). 78 = 19.5 dBm.

    config MESH_ENCRYPTION
        bool "Encrypt unicast ESP-NOW traffic (PMK/LMK, CCMP)"
        default n
        help
            When enabled, every unicast peer is added with encrypt=true and the
            local master key below. Broadcast frames (JOIN) are always
            plaintext - this is an ESP-NOW limitation. See docs/PROTOCOL.md
            "Security model" for the threat model and the limits (at most
            17 encrypted peers).

    config MESH_PMK
        string "Primary master key (32 hex characters)"
        depends on MESH_ENCRYPTION
        default "a1b2c3d4e5f60718293a4b5c6d7e8f90"
        help
            16-byte PMK used to encrypt the LMKs. CHANGE THIS for any real
            deployment; the default is public.

    config MESH_LMK
        string "Local master key (32 hex characters)"
        depends on MESH_ENCRYPTION
        default "0f1e2d3c4b5a69788796a5b4c3d2e1f0"
        help
            16-byte LMK shared by the gateway and all nodes. CHANGE THIS for
            any real deployment; the default is public.

endmenu
```

## gateway/main/Kconfig.projbuild
```kconfig
menu "Gateway"

    config GW_MAX_NODES
        int "Maximum registered nodes"
        range 1 19
        default 16
        help
            ESP-NOW allows 20 peers in total (one is the broadcast peer) and
            at most 17 encrypted peers (CONFIG_ESP_WIFI_ESPNOW_MAX_ENCRYPT_NUM).
            Larger fleets need peer rotation - see docs "Future work".

    config GW_RX_QUEUE_LEN
        int "Radio RX queue depth (frames)"
        range 4 128
        default 32

    config GW_OUT_QUEUE_LEN
        int "Output (JSON) queue depth (records, allocated in PSRAM when available)"
        range 16 2048
        default 256

    config GW_SUSPECT_MISSES
        int "Missed heartbeats before a node is SUSPECT"
        range 1 20
        default 2

    config GW_OFFLINE_MISSES
        int "Missed heartbeats before a node is OFFLINE"
        range 2 50
        default 4

    config GW_LIVENESS_GRACE_MS
        int "Grace period added to liveness thresholds (ms)"
        default 1000

    config GW_STATS_PERIOD_S
        int "Period of gw_stats and link records (s)"
        range 5 3600
        default 30

    config GW_QUEUE_PRESSURE_PCT
        int "Queue fill level that enters DEGRADED (%)"
        range 10 100
        default 75

    config GW_QUEUE_RELIEF_PCT
        int "Queue fill level that returns to RUNNING (%)"
        range 0 90
        default 25

    config GW_CONFIG_ATTEMPTS
        int "Transmissions of a CONFIG frame before giving up"
        range 1 8
        default 4

    config GW_CONFIG_ACK_TIMEOUT_MS
        int "ACK timeout for CONFIG frames (ms)"
        default 100

    config GW_RADIO_INIT_RETRIES
        int "Radio bring-up attempts before restarting the chip"
        default 5

    config GW_QUIET_LOGS
        bool "Lower ESP_LOG level to WARN once running (keeps the JSON stream clean)"
        default y

endmenu
```

## sensor_node/components/sensor_hal/Kconfig
```kconfig
menu "Sensor node: sensor backends"

    choice SENSOR_MODE
        prompt "Sensor source"
        default SENSOR_MODE_SIMULATED
        help
            Simulated mode needs no hardware and is what CI and the host
            simulator exercise. Hardware mode enables any combination of the
            real drivers below.

        config SENSOR_MODE_SIMULATED
            bool "Simulated (deterministic, no hardware)"
        config SENSOR_MODE_HARDWARE
            bool "Real hardware"
    endchoice

    config SENSOR_SIM_SEED
        int "Simulation seed (mixed with the node id)"
        depends on SENSOR_MODE_SIMULATED
        default 42

    config SENSOR_MQ2_ENABLE
        bool "MQ-2 gas sensor (analogue, ADC1)"
        depends on SENSOR_MODE_HARDWARE
        default y

    menu "MQ-2 settings"
        depends on SENSOR_MQ2_ENABLE

        config SENSOR_MQ2_GPIO
            int "ADC1 input GPIO"
            range 1 10
            default 4
            help
                ESP32-S3 ADC1 is on GPIO1..GPIO10. ADC2 cannot be used while
                Wi-Fi is active, so only ADC1 pins are accepted.

        config SENSOR_MQ2_DIVIDER_TOP_OHM
            int "Divider resistor AO -> ADC pin (ohm, 0 = no divider)"
            default 10000
            help
                The MQ-2 module output swings up to 5 V; the ESP32-S3 ADC
                tolerates 3.3 V. Use a divider (e.g. 10k/20k).

        config SENSOR_MQ2_DIVIDER_BOTTOM_OHM
            int "Divider resistor ADC pin -> GND (ohm)"
            default 20000

        config SENSOR_MQ2_RL_OHM
            int "Module load resistor RL (ohm)"
            default 1000

        config SENSOR_MQ2_VC_MV
            int "Circuit supply Vc (mV)"
            default 5000

        config SENSOR_MQ2_R0_OHM
            int "Default R0 (clean-air resistance, ohm) if not calibrated"
            default 10000

        config SENSOR_MQ2_WARMUP_S
            int "Heater warm-up before readings are flagged valid (s)"
            default 60
            help
                The datasheet recommends >24 h preheat for best accuracy;
                readings are flagged MESH_STATUS_WARMING_UP until this elapses.

        config SENSOR_MQ2_AUTOCAL
            bool "Calibrate R0 in clean air after warm-up and store it in NVS"
            default y

        config SENSOR_MQ2_OVERSAMPLE
            int "ADC samples averaged per reading"
            range 1 256
            default 32
    endmenu

    config SENSOR_MOTOR_ENABLE
        bool "R380 DC motor (PWM via H-bridge) + AS5600 magnetic encoder (I2C)"
        depends on SENSOR_MODE_HARDWARE
        default n

    menu "Motor + AS5600 settings"
        depends on SENSOR_MOTOR_ENABLE

        config SENSOR_MOTOR_PWM_GPIO
            int "PWM output GPIO (H-bridge enable / IN1)"
            default 5
        config SENSOR_MOTOR_DIR_GPIO
            int "Direction GPIO (H-bridge IN2), -1 if unused"
            default 6
        config SENSOR_MOTOR_PWM_FREQ_HZ
            int "PWM frequency (Hz)"
            range 1000 40000
            default 20000
            help
                20 kHz is above the audible range; the LEDC timer uses 10-bit
                resolution at this frequency.
        config SENSOR_MOTOR_DUTY_PCT
            int "Open-loop duty cycle (%)"
            range 0 100
            default 50
        config SENSOR_MOTOR_RAMP_MS
            int "Soft-start ramp duration (ms)"
            default 2000
            help
                Limits inrush current of the brushed motor at start-up.
        config SENSOR_MOTOR_RPM_WINDOW_MS
            int "Speed measurement window (ms)"
            range 5 1000
            default 50
            help
                The AS5600 angle is sampled once per RTOS tick (1 kHz) during
                this window and unwrapped. Unambiguous up to 30000 rpm on the
                encoder shaft (< half a turn per sample).
    endmenu

    config SENSOR_MPU6050_ENABLE
        bool "MPU-6050 IMU on GY-521 board (I2C)"
        depends on SENSOR_MODE_HARDWARE
        default n

    menu "MPU-6050 settings"
        depends on SENSOR_MPU6050_ENABLE

        config SENSOR_MPU6050_ADDR
            hex "I2C address (0x68 with AD0 low, 0x69 high)"
            default 0x68
        config SENSOR_MPU6050_GYRO_CAL_SAMPLES
            int "Gyro bias samples at boot (0 = skip, device must be still)"
            default 200
    endmenu

    menu "I2C bus (shared by AS5600 and MPU-6050)"
        depends on SENSOR_MOTOR_ENABLE || SENSOR_MPU6050_ENABLE

        config SENSOR_I2C_SDA_GPIO
            int "SDA GPIO"
            default 8
        config SENSOR_I2C_SCL_GPIO
            int "SCL GPIO"
            default 9
        config SENSOR_I2C_FREQ_HZ
            int "SCL frequency (Hz)"
            default 400000
    endmenu

endmenu
```

## sensor_node/main/Kconfig.projbuild
```kconfig
menu "Sensor node"

    config NODE_ID
        int "Node id (0 = derive from the Wi-Fi MAC)"
        range 0 65534
        default 0
        help
            Stored in NVS on first boot. A non-zero value overrides the
            MAC-derived id. The gateway rejects a JOIN whose id is already
            owned by another MAC.

    config NODE_GATEWAY_MAC
        string "Gateway MAC (aa:bb:cc:dd:ee:ff), empty = discover"
        default ""
        help
            Empty: the node accepts the first JOIN_ACK it receives and uses its
            source as the gateway. Set: only that gateway is accepted.
            REQUIRED when ESP-NOW encryption is enabled, because the node must
            register the gateway as an encrypted peer before it can decrypt
            the (encrypted) JOIN_ACK.

    config NODE_REPORT_INTERVAL_MS
        int "Default reading interval (ms)"
        range 100 3600000
        default 1000

    config NODE_HEARTBEAT_INTERVAL_MS
        int "Default heartbeat interval (ms)"
        range 1000 600000
        default 5000

    config NODE_TX_QUEUE_LEN
        int "TX queue depth (readings buffered while the link is down)"
        range 2 64
        default 8
        help
            When full, the oldest reading is dropped (fresh data is worth more
            than stale data) and queue_drops is incremented.

    menu "Reliability"
        config NODE_TX_MAX_ATTEMPTS
            int "Transmissions per frame (including the first)"
            range 1 8
            default 4
        config NODE_ACK_TIMEOUT_MS
            int "ACK timeout per attempt (ms)"
            range 5 1000
            default 30
        config NODE_BACKOFF_BASE_MS
            int "Retry backoff base (ms), doubled per retry"
            range 1 1000
            default 20
        config NODE_BACKOFF_MAX_MS
            int "Retry backoff cap (ms)"
            range 1 10000
            default 200
        config NODE_BACKOFF_JITTER_MS
            int "Retry jitter, uniform [0, n) ms"
            range 0 1000
            default 10
        config NODE_GATEWAY_LOST_FAILURES
            int "Consecutive undelivered frames before re-joining"
            range 1 100
            default 3
        config NODE_JOIN_TIMEOUT_MS
            int "Wait for JOIN_ACK (ms)"
            default 300
        config NODE_JOIN_BACKOFF_MAX_MS
            int "Maximum delay between JOIN attempts (ms)"
            default 30000
    endmenu

    menu "Supervision"
        config NODE_SUPERVISOR_PERIOD_MS
            int "Supervisor period (ms)"
            default 1000
        config NODE_TASK_STALL_MS
            int "Stall budget for the TX task (ms) before rebooting"
            default 10000
            help
                The sensor and heartbeat budgets are derived from their
                (runtime-configurable) intervals: 2 x interval + 5 s.
        config NODE_LOW_HEAP_BYTES
            int "Warn when free internal heap drops below (bytes)"
            default 20000
    endmenu

endmenu
```
